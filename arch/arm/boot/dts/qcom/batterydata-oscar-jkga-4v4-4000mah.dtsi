qcom,oscar_jkga_4000mah {
	qcom,max-voltage-uv = <4400000>;
	qcom,nom-batt-capacity-mah = <4000>;
	qcom,batt-id-kohm = <50>;
	qcom,cool-fastchg-current-comp = <900>;
	qcom,battery-beta = <3435>;
	qcom,thermal-coefficients = [c2 86 bb 50 cf 37];
	qcom,battery-type = "oscar_jkga_4000mah";
	qcom,chg-rslow-comp-c1 = <4337391>;
	qcom,chg-rslow-comp-c2 = <7794215>;
	qcom,chg-rs-to-rslow = <1180736>;
	qcom,chg-rslow-comp-thr = <0xb8>;
	qcom,checksum = <0x98f8>;
	qcom,gui-version = "PMI8950GUI - 2.0.0.16";
	qcom,fg-profile-data = <0x9d83876f 0xe378cc65 0x37832778 0x2085f981 0xe78110a0 0xe7bf40d1 0x6610d183 0xcb761c7b 0x3d6f2e83 0x597a6d8c 0xd1882082 0xeb9b7dc4 0xdd3640d 0x9f0ffd58 0x1470eefc 0xd92f5b3f 0xfe3a0000 0x9f4c6c41 0x3f310000 0x0 0x0 0x6f717b6b 0x4e6e1289 0x677d2573 0x76d1c78 0xa8760370 0x366c8ca2 0x30206136 0x5fa0710c 0x2800ff36 0xf0113003 0xc>;
};
