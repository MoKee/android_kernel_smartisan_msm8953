#include "u3-p1-msm8953-charging-odin.dtsi"
#include "u3-p1-msm8953-goodix-odin.dtsi"
#include "u3-p1-msm8953-idex-odin.dtsi"
#include "u3-p1-msm8953-special-odin-audio.dtsi"
#include "u3-p1-msm8953-haptics-odin.dtsi"
#include "u3-p1-msm8953-key-odin.dtsi"
#include "u3-p1-msm8953-leds-odin.dtsi"
