&mdss_mdp {
	dsi_td4310_tcl_1080p_vid: qcom,mdss_dsi_td4310_tcl_1080p_video {
		qcom,mdss-dsi-panel-name = "td4310 1080p  video mode dsi panel";
		qcom,mdss-dsi-panel-controller = <&mdss_dsi0>;
		qcom,mdss-dsi-panel-type = "dsi_video_mode";
		qcom,mdss-dsi-panel-destination = "display_1";
		qcom,mdss-dsi-panel-framerate = <58>;
		qcom,mdss-dsi-virtual-channel-id = <0>;
		qcom,mdss-dsi-stream = <0>;
		qcom,mdss-dsi-panel-width = <1080>;
		qcom,mdss-dsi-panel-height = <2160>;
		qcom,mdss-dsi-h-front-porch = <320>;
		qcom,mdss-dsi-h-back-porch = <20>;
		qcom,mdss-dsi-h-pulse-width = <2>;
		qcom,mdss-dsi-h-sync-skew = <0>;
		qcom,mdss-dsi-v-back-porch = <31>;
		qcom,mdss-dsi-v-front-porch = <4>;
		qcom,mdss-dsi-v-pulse-width = <2>;
		qcom,mdss-dsi-h-left-border = <0>;
		qcom,mdss-dsi-h-right-border = <0>;
		qcom,mdss-dsi-v-top-border = <0>;
		qcom,mdss-dsi-v-bottom-border = <4>;
		qcom,mdss-dsi-bpp = <24>;
		qcom,mdss-dsi-color-order = "rgb_swap_rgb";
		qcom,mdss-dsi-underflow-color = <0xff>;
		qcom,mdss-dsi-border-color = <0>;

		qcom,mdss-dsi-panel-sre-exit = [29 01 00 00 00 00 02 b0 04 15 01 00 00 00 00 02 51 ff 15 01 00 00 00 00 02 53 2c 15 01 00 00 00 00 02 55 82 29 01 00 00 00 00 08 b8 67 4b 06 00 04 00 00 29 01 00 00 00 00 08 b9 99 4b 10 00 07 00 00 29 01 00 00 00 00 08 ba bb 43 17 00 09 00 00 29 01 00 00 00 00 2c ca 1d fc fc fc 00 15 03 0b 00 cf e5 e7 00 2f 00 f9 f9 f9 00 fc 00 d0 9f 6b 61 a0 6f 58 4d 00 c5 f2 55 bf ff 4e 00 00 00 00 00 00 00 29 01 00 00 00 00 02 f9 64 29 01 00 00 00 00 02 b0 03];
		qcom,mdss-dsi-panel-sre-middle-1-level = <0x29010000 0x2b0 0x4290100 0x3 0xbd210029 0x1000000 0x2b003>;
		qcom,mdss-dsi-panel-sre-middle-2-level = <0x29010000 0x2b0 0x4290100 0x3 0xbd2e0029 0x1000000 0x2b003>;
		qcom,mdss-dsi-panel-sre-middle-3-level = <0x29010000 0x2b0 0x4290100 0x3 0xbd3b0029 0x1000000 0x2b003>;
		qcom,mdss-dsi-panel-sre-middle-4-level = <0x29010000 0x2b0 0x4290100 0x3 0xbd480029 0x1000000 0x2b003>;
		qcom,mdss-dsi-panel-sre-middle-5-level = <0x29010000 0x2b0 0x4290100 0x3 0xbd550029 0x1000000 0x2b003>;
		qcom,mdss-dsi-panel-sre-middle-6-level = <0x29010000 0x2b0 0x4290100 0x3 0xbd640029 0x1000000 0x2b003>;
		qcom,mdss-dsi-panel-sre-middle-level = [29 01 00 00 00 00 02 b0 04 15 01 00 00 00 00 02 51 ff 15 01 00 00 00 00 02 53 2c 15 01 00 00 00 00 02 55 f1 29 01 00 00 00 00 08 b8 6e f1 64 32 00 40 00 29 01 00 00 00 00 03 bd 64 00 29 01 00 00 00 00 2c ca 1d fc fc fc 00 12 00 14 00 f5 f5 f5 00 13 db 00 ed c5 00 f1 00 f5 9f 6b 61 a1 6b 59 4d 00 00 00 00 00 00 00 00 00 00 00 00 00 00 29 01 00 00 00 00 02 f9 64 29 01 00 00 00 00 02 b0 03];
		qcom,mdss-dsi-panel-sre-strong-level = [29 01 00 00 00 00 02 b0 04 15 01 00 00 00 00 02 51 ff 15 01 00 00 00 00 02 53 2c 15 01 00 00 00 00 02 55 f1 29 01 00 00 00 00 08 b8 6e f1 64 32 00 40 00 29 01 00 00 00 00 03 bd 74 00 29 01 00 00 00 00 2c ca 1d fc fc fc 00 15 03 0b 00 cf e5 e7 00 2f 00 f9 f9 f9 00 fc 00 d0 9f 6b 61 a0 6f 58 4d 00 c5 f2 55 bf ff 4e 00 00 00 00 00 00 00 29 01 00 00 00 00 02 f9 64 29 01 00 00 00 00 02 b0 03];
		qcom,mdss-dsi-panel-sre-weak-level = [29 01 00 00 00 00 02 b0 04 15 01 00 00 00 00 02 51 ff 15 01 00 00 00 00 02 53 2c 15 01 00 00 00 00 02 55 f1 29 01 00 00 00 00 08 b8 6e f1 64 32 00 40 00 29 01 00 00 00 00 03 bd 14 00 29 01 00 00 00 00 2c ca 1d fc fc fc 00 15 03 0b 00 cf e5 e7 00 2f 00 f9 f9 f9 00 fc 00 d0 9f 6b 61 a0 6f 58 4d 00 c5 f2 55 bf ff 4e 00 00 00 00 00 00 00 29 01 00 00 00 00 02 f9 64 29 01 00 00 00 00 02 b0 03];

		qcom,mdss-dsi-panel-color-temperature-command = [29 01 00 00 00 00 02 b0 04 15 01 00 00 00 00 02 51 ff 15 01 00 00 00 00 02 53 2c 15 01 00 00 00 00 02 55 82 29 01 00 00 26 00 2c ca 1d fc fc fc 00 15 03 0b 00 cf 40 00 00 2f 00 f9 00 07 17 fc 00 d0 9f 6b 61 a0 6f 4e 4d 00 c5 f2 55 bf ff 4e 00 00 00 00 00 00 00 29 01 00 00 26 00 13 c8 03 00 00 00 00 fc 00 00 00 00 00 fc 00 00 00 00 00 fc 29 01 00 00 26 00 13 c8 03 00 00 00 00 fc 00 00 00 00 00 fa 00 00 00 00 00 fa 29 01 00 00 26 00 13 c8 03 00 00 00 00 fc 00 00 00 00 00 f8 00 00 00 00 00 f6 29 01 00 00 26 00 13 c8 03 00 00 00 00 fc 00 00 00 00 00 f6 00 00 00 00 00 f2 29 01 00 00 26 00 13 c8 03 00 00 00 00 fc 00 00 00 00 00 f4 00 00 00 00 00 ee 29 01 00 00 26 00 13 c8 03 00 00 00 00 fc 00 00 00 00 00 f2 00 00 00 00 00 ea 29 01 00 00 26 00 13 c8 03 00 00 00 00 fc 00 00 00 00 00 f1 00 00 00 00 00 e6 29 01 00 00 26 00 13 c8 03 00 00 00 00 fc 00 00 00 00 00 f0 00 00 00 00 00 e2 29 01 00 00 26 00 13 c8 03 00 00 00 00 fc 00 00 00 00 00 ef 00 00 00 00 00 de 29 01 00 00 26 00 13 c8 03 00 00 00 00 fc 00 00 00 00 00 ee 00 00 00 00 00 da 29 01 00 00 26 00 13 c8 03 00 00 00 00 fd 00 00 00 00 00 ed 00 00 00 00 00 d6 29 01 00 00 26 00 13 c8 03 00 00 00 00 fd 00 00 00 00 00 ec 00 00 00 00 00 d2 29 01 00 00 26 00 13 c8 03 00 00 00 00 fd 00 00 00 00 00 eb 00 00 00 00 00 ce 29 01 00 00 26 00 13 c8 03 00 00 00 00 fd 00 00 00 00 00 ea 00 00 00 00 00 ca 29 01 00 00 26 00 13 c8 03 00 00 00 00 fd 00 00 00 00 00 e9 00 00 00 00 00 c6 29 01 00 00 26 00 13 c8 03 00 00 00 00 fd 00 00 00 00 00 e8 00 00 00 00 00 c2 29 01 00 00 26 00 13 c8 03 00 00 00 00 fd 00 00 00 00 00 e7 00 00 00 00 00 be 29 01 00 00 26 00 13 c8 03 00 00 00 00 fd 00 00 00 00 00 e6 00 00 00 00 00 ba 29 01 00 00 26 00 13 c8 03 00 00 00 00 fd 00 00 00 00 00 e5 00 00 00 00 00 b6 29 01 00 00 26 00 13 c8 03 00 00 00 00 fd 00 00 00 00 00 e4 00 00 00 00 00 b2 29 01 00 00 26 00 13 c8 03 00 00 00 00 fe 00 00 00 00 00 e3 00 00 00 00 00 ae 29 01 00 00 26 00 13 c8 03 00 00 00 00 fe 00 00 00 00 00 e2 00 00 00 00 00 aa 29 01 00 00 26 00 13 c8 03 00 00 00 00 fe 00 00 00 00 00 e1 00 00 00 00 00 a6 29 01 00 00 26 00 13 c8 03 00 00 00 00 fe 00 00 00 00 00 e0 00 00 00 00 00 a2 29 01 00 00 26 00 13 c8 03 00 00 00 00 fe 00 00 00 00 00 df 00 00 00 00 00 9e 29 01 00 00 26 00 13 c8 03 00 00 00 00 fe 00 00 00 00 00 de 00 00 00 00 00 9a 29 01 00 00 26 00 13 c8 03 00 00 00 00 fe 00 00 00 00 00 dd 00 00 00 00 00 96 29 01 00 00 26 00 13 c8 03 00 00 00 00 fe 00 00 00 00 00 dc 00 00 00 00 00 92 29 01 00 00 00 00 08 b8 67 4b 06 00 04 00 00 29 01 00 00 00 00 08 b9 99 4b 07 00 07 00 00 29 01 00 00 00 00 08 ba bb 43 17 00 09 00 00 29 01 00 00 00 00 02 b0 03];
		qcom,mdss-dsi-panel-color-temperature-command-restore = [29 01 00 00 00 00 02 b0 04 15 01 00 00 00 00 02 51 ff 15 01 00 00 00 00 02 53 2c 15 01 00 00 00 00 02 55 82 29 01 00 00 00 00 2c ca 1d fc fc fc 00 15 03 0b 00 cf e5 e7 00 2f 00 f9 f9 f9 00 fc 00 d0 9f 6b 61 a0 6f 58 4d 00 c5 f2 55 bf ff 4e 00 00 00 00 00 00 00 29 01 00 00 26 00 13 c8 03 00 00 00 00 fe 00 00 00 00 00 dc 00 00 00 00 00 92 29 01 00 00 26 00 13 c8 03 00 00 00 00 fe 00 00 00 00 00 dd 00 00 00 00 00 96 29 01 00 00 26 00 13 c8 03 00 00 00 00 fe 00 00 00 00 00 de 00 00 00 00 00 9a 29 01 00 00 26 00 13 c8 03 00 00 00 00 fe 00 00 00 00 00 df 00 00 00 00 00 9e 29 01 00 00 26 00 13 c8 03 00 00 00 00 fe 00 00 00 00 00 e0 00 00 00 00 00 a2 29 01 00 00 26 00 13 c8 03 00 00 00 00 fe 00 00 00 00 00 e1 00 00 00 00 00 a6 29 01 00 00 26 00 13 c8 03 00 00 00 00 fe 00 00 00 00 00 e2 00 00 00 00 00 aa 29 01 00 00 26 00 13 c8 03 00 00 00 00 fe 00 00 00 00 00 e3 00 00 00 00 00 ae 29 01 00 00 26 00 13 c8 03 00 00 00 00 fd 00 00 00 00 00 e4 00 00 00 00 00 b2 29 01 00 00 26 00 13 c8 03 00 00 00 00 fd 00 00 00 00 00 e5 00 00 00 00 00 b6 29 01 00 00 26 00 13 c8 03 00 00 00 00 fd 00 00 00 00 00 e6 00 00 00 00 00 ba 29 01 00 00 26 00 13 c8 03 00 00 00 00 fd 00 00 00 00 00 e7 00 00 00 00 00 be 29 01 00 00 26 00 13 c8 03 00 00 00 00 fd 00 00 00 00 00 e8 00 00 00 00 00 c2 29 01 00 00 26 00 13 c8 03 00 00 00 00 fd 00 00 00 00 00 e9 00 00 00 00 00 c6 29 01 00 00 26 00 13 c8 03 00 00 00 00 fd 00 00 00 00 00 ea 00 00 00 00 00 ca 29 01 00 00 26 00 13 c8 03 00 00 00 00 fd 00 00 00 00 00 eb 00 00 00 00 00 ce 29 01 00 00 26 00 13 c8 03 00 00 00 00 fd 00 00 00 00 00 ec 00 00 00 00 00 d2 29 01 00 00 26 00 13 c8 03 00 00 00 00 fd 00 00 00 00 00 ed 00 00 00 00 00 d6 29 01 00 00 26 00 13 c8 03 00 00 00 00 fc 00 00 00 00 00 ee 00 00 00 00 00 da 29 01 00 00 26 00 13 c8 03 00 00 00 00 fc 00 00 00 00 00 ef 00 00 00 00 00 de 29 01 00 00 26 00 13 c8 03 00 00 00 00 fc 00 00 00 00 00 f0 00 00 00 00 00 e2 29 01 00 00 26 00 13 c8 03 00 00 00 00 fc 00 00 00 00 00 f1 00 00 00 00 00 e6 29 01 00 00 26 00 13 c8 03 00 00 00 00 fc 00 00 00 00 00 f2 00 00 00 00 00 ea 29 01 00 00 26 00 13 c8 03 00 00 00 00 fc 00 00 00 00 00 f4 00 00 00 00 00 ee 29 01 00 00 26 00 13 c8 03 00 00 00 00 fc 00 00 00 00 00 f6 00 00 00 00 00 f2 29 01 00 00 26 00 13 c8 03 00 00 00 00 fc 00 00 00 00 00 f8 00 00 00 00 00 f6 29 01 00 00 26 00 13 c8 03 00 00 00 00 fc 00 00 00 00 00 fa 00 00 00 00 00 fa 29 01 00 00 26 00 13 c8 03 00 00 00 00 fc 00 00 00 00 00 fc 00 00 00 00 00 fc 29 01 00 00 26 00 13 c8 00 00 00 00 00 fc 00 00 00 00 00 fc 00 00 00 00 00 fc 29 01 00 00 00 00 08 b8 67 4b 06 00 04 00 00 29 01 00 00 00 00 08 b9 99 4b 10 00 07 00 00 29 01 00 00 00 00 08 ba bb 43 17 00 09 00 00 29 01 00 00 00 00 02 b0 03];
		qcom,mdss-dsi-panel-color-temperature-command_resume = <0x29010000 0x2b0 0x4290100 0x26002c 0xca1dfcfc 0xfc001503 0xb00cf40 0x2f00 0xf9000717 0xfc00d09f 0x6b61a06f 0x4e4d00c5 0xf255bfff 0x4e000000 0x0 0x29010000 0x13c8 0x3000000 0xfe0000 0xdc 0x0 0x922901 0x0 0x8b8674b 0x6000400 0x290100 0x8 0xb9994b07 0x70000 0x29010000 0x8ba 0xbb431700 0x9000029 0x1000000 0x2b003>;

		qcom,mdss-dsi-panel-cabc-moving-mode-td4310 = [29 01 00 00 00 00 02 b0 04 29 01 00 00 00 00 02 d6 01 15 01 00 00 00 00 02 51 ff 15 01 00 00 00 00 02 53 2c 15 01 00 00 00 00 02 55 83 29 01 00 00 00 00 27 c7 0a 21 2d 3e 4c 57 70 80 8d 99 4c 58 67 7b 84 8f 9d a8 b4 0a 21 2d 3e 4c 57 70 80 8d 99 4c 58 67 7b 84 8f 9d a8 b4 29 01 00 00 00 00 14 c8 00 00 00 00 00 fc 00 00 00 00 00 fc 00 00 00 00 00 fc 00 29 01 00 00 00 00 08 b8 67 4b 06 00 04 00 00 29 01 00 00 00 00 08 b9 99 4b 10 00 07 00 00 29 01 00 00 00 00 08 ba bb 43 17 00 09 00 00 29 01 00 00 00 00 1a ce 55 40 60 78 87 94 9e ab b8 c4 cd d6 de e5 ec f3 ff 00 e3 04 04 42 04 69 5a 29 01 00 00 00 00 2c ca 1d fc fc fc 00 15 03 0b 00 cf e5 e7 00 2f 00 f9 f9 f9 00 fc 00 d0 9f 6b 61 a0 6f 58 4d 00 c5 f2 55 bf ff 4e 00 00 00 00 00 00 00 29 01 00 00 00 00 02 f9 64 29 01 00 00 00 00 02 b0 03];
		qcom,mdss-dsi-panel-cabc-still-mode-td4310 = [29 01 00 00 00 00 02 b0 04 29 01 00 00 00 00 02 d6 01 15 01 00 00 00 00 02 51 ff 15 01 00 00 00 00 02 53 2c 15 01 00 00 00 00 02 55 82 29 01 00 00 00 00 27 c7 0a 21 2d 3e 4c 57 70 80 8d 99 4c 58 67 7b 84 8f 9d a8 b4 0a 21 2d 3e 4c 57 70 80 8d 99 4c 58 67 7b 84 8f 9d a8 b4 29 01 00 00 00 00 14 c8 00 00 00 00 00 fc 00 00 00 00 00 fc 00 00 00 00 00 fc 00 29 01 00 00 00 00 08 b8 67 4b 06 00 04 00 00 29 01 00 00 00 00 08 b9 99 4b 10 00 07 00 00 29 01 00 00 00 00 08 ba bb 43 17 00 09 00 00 29 01 00 00 00 00 1a ce 55 40 60 78 87 94 9e ab b8 c4 cd d6 de e5 ec f3 ff 00 e3 04 04 42 04 69 5a 29 01 00 00 00 00 2c ca 1d fc fc fc 00 15 03 0b 00 cf e5 e7 00 2f 00 f9 f9 f9 00 fc 00 d0 9f 6b 61 a0 6f 58 4d 00 c5 f2 55 bf ff 4e 00 00 00 00 00 00 00 29 01 00 00 00 00 02 f9 64 29 01 00 00 00 00 02 b0 03];
		qcom,mdss-dsi-panel-cabc-ui-mode-td4310 = [29 01 00 00 00 00 02 b0 04 29 01 00 00 00 00 02 d6 01 15 01 00 00 00 00 02 51 ff 15 01 00 00 00 00 02 53 2c 15 01 00 00 00 00 02 55 81 29 01 00 00 00 00 27 c7 0a 21 2d 3e 4c 57 70 80 8d 99 4c 58 67 7b 84 8f 9d a8 b4 0a 21 2d 3e 4c 57 70 80 8d 99 4c 58 67 7b 84 8f 9d a8 b4 29 01 00 00 00 00 14 c8 00 00 00 00 00 fc 00 00 00 00 00 fc 00 00 00 00 00 fc 00 29 01 00 00 00 00 08 b8 67 4b 06 00 04 00 00 29 01 00 00 00 00 08 b9 99 4b 10 00 07 00 00 29 01 00 00 00 00 08 ba bb 43 17 00 09 00 00 29 01 00 00 00 00 1a ce 55 40 60 78 87 94 9e ab b8 c4 cd d6 de e5 ec f3 ff 00 e3 04 04 42 04 69 5a 29 01 00 00 00 00 2c ca 1d fc fc fc 00 15 03 0b 00 cf e5 e7 00 2f 00 f9 f9 f9 00 fc 00 d0 9f 6b 61 a0 6f 58 4d 00 c5 f2 55 bf ff 4e 00 00 00 00 00 00 00 29 01 00 00 00 00 02 f9 64 29 01 00 00 00 00 02 b0 03];

		qcom,mdss-dsi-off-command = [05 01 00 00 14 00 02 28 00 05 01 00 00 78 00 02 10 00];
		qcom,mdss-dsi-on-command-state = "dsi_lp_mode";
		qcom,mdss-dsi-on-command = [05 01 00 00 64 00 02 11 00 29 01 00 00 00 00 02 b0 00 29 01 00 00 00 00 04 b3 31 00 06 29 01 00 00 00 00 02 b4 00 29 01 00 00 00 00 06 b6 33 5b 81 12 00 29 01 00 00 00 00 08 b8 67 4b 06 00 04 00 00 29 01 00 00 00 00 08 b9 99 4b 10 00 07 00 00 29 01 00 00 00 00 08 ba bb 43 17 00 09 00 00 29 01 00 00 00 00 03 bb 14 14 29 01 00 00 00 00 03 bc 37 32 29 01 00 00 00 00 03 bd 64 32 29 01 00 00 00 00 02 be 04 29 01 00 00 00 00 02 c0 00 29 01 00 00 00 00 31 c1 04 40 00 ff ff c0 9a 2b e3 bf ff ff 97 11 c2 28 ff ff ff 7d 41 5c 63 e0 ff 0f 00 00 00 00 00 00 00 00 40 02 62 11 06 02 02 00 01 00 01 00 00 00 29 01 00 00 00 00 19 c2 01 f8 70 08 64 04 0c 10 00 08 30 00 00 00 00 00 00 00 00 08 00 00 00 00 29 01 00 00 00 00 3f c3 86 58 65 86 50 00 00 00 00 00 41 b4 1b 00 00 46 14 61 00 00 01 01 03 28 00 01 00 01 00 00 15 00 15 00 2c 01 00 00 00 00 00 00 00 00 00 00 00 00 28 00 28 00 5a 02 00 00 00 00 00 00 08 08 29 01 00 00 00 00 15 c4 70 00 00 00 00 00 00 00 00 02 02 31 01 00 00 00 02 01 01 01 29 01 00 00 00 00 09 c5 08 00 00 00 00 70 00 00 29 01 00 00 00 00 40 c6 44 00 44 03 3d 01 0e 01 02 01 02 01 02 00 00 00 00 07 0e 04 44 00 47 54 00 00 00 00 00 00 00 00 00 00 00 00 00 00 00 00 00 00 00 00 00 00 00 00 00 00 00 00 00 00 00 00 00 00 00 00 00 00 00 29 01 00 00 00 00 27 c7 0a 21 2d 3e 4c 57 70 80 8d 99 4c 58 67 7b 84 8f 9d a8 b4 0a 21 2d 3e 4c 57 70 80 8d 99 4c 58 67 7b 84 8f 9d a8 b4 29 01 00 00 00 00 38 c8 00 00 00 00 00 fc 00 00 00 00 00 fc 00 00 00 00 00 fc 00 00 00 00 00 fc 00 00 00 00 00 fc 00 00 00 00 00 fc 00 00 00 00 00 fc 00 00 00 00 00 fc 00 00 00 00 00 fc 00 29 01 00 00 00 00 14 c9 00 00 00 00 00 fc 00 00 00 00 00 fc 00 00 00 00 00 fc 00 29 01 00 00 00 00 2c ca 1d fc fc fc 00 15 03 0b 00 cf e5 e7 00 2f 00 f9 f9 f9 00 fc 00 d0 9f 6b 61 a0 6f 58 4d 00 c5 f2 55 bf ff 4e 00 00 00 00 00 00 00 29 01 00 00 00 00 1c cb f8 85 1f fa 0d 40 00 00 20 00 11 50 00 0d 00 00 00 00 00 00 00 00 00 00 00 00 00 29 01 00 00 00 00 03 cc 37 00 29 01 00 00 00 00 27 cd 1d 00 23 00 23 00 5c 02 bf bf e3 e3 af af e2 e2 01 00 00 00 00 00 00 00 00 00 00 00 00 00 00 00 00 00 00 00 00 a2 29 01 00 00 00 00 1a ce 55 40 60 78 87 94 9e ab b8 c4 cd d6 de e5 ec f3 ff 00 e3 04 04 42 04 69 5a 29 01 00 00 00 00 03 cf 48 1d 29 01 00 00 00 00 14 d0 33 59 cf 31 01 10 10 10 19 19 00 00 00 00 00 00 00 6d 65 29 01 00 00 00 00 02 d1 00 29 01 00 00 00 00 16 d3 1b 3b bb 77 77 77 bb b3 33 00 00 6e 60 e7 e7 33 bb f2 fd c6 0b 29 01 00 00 00 00 02 d6 01 29 01 00 00 00 00 22 d7 86 ff 03 05 41 24 80 1f c7 1f 1b 00 0c 07 20 00 00 00 00 00 0c f0 07 00 0c 00 00 aa 67 7e 1d 06 00 29 01 00 00 00 00 08 d9 00 30 14 3e 05 77 02 29 01 00 00 00 00 05 dd 30 06 23 65 29 01 00 00 00 00 02 ea 9f 29 01 00 00 00 00 04 ee 41 51 00 29 01 00 00 00 00 04 f1 00 00 00 29 01 00 00 00 00 02 b0 04 29 01 00 00 00 00 02 f9 64 29 01 00 00 00 00 02 b0 03 39 01 00 00 00 00 02 51 ff 39 01 00 00 00 00 02 53 24 39 01 00 00 00 00 02 55 82 05 01 00 00 14 00 02 29 00];
		qcom,mdss-dsi-off-command-state = "dsi_hs_mode";

		qcom,mdss-dsi-h-sync-pulse = <1>;
		qcom,mdss-dsi-traffic-mode = "burst_mode";
		qcom,mdss-dsi-lane-map = "lane_map_0123";
		qcom,mdss-dsi-bllp-eof-power-mode;
		qcom,mdss-dsi-bllp-power-mode;
		qcom,mdss-dsi-lane-0-state;
		qcom,mdss-dsi-lane-1-state;
		qcom,mdss-dsi-lane-2-state;
		qcom,mdss-dsi-lane-3-state;
		qcom,mdss-dsi-panel-timings = <0xee382600 0x6a6c2c3c 0x2c030400>;
		qcom,mdss-dsi-t-clk-post = <0x0d>;
		qcom,mdss-dsi-t-clk-pre = <0x30>;
		qcom,mdss-dsi-bl-min-level = <1>;
		qcom,mdss-dsi-bl-max-level = <4095>;
		qcom,mdss-dsi-dma-trigger = "trigger_sw";
		qcom,mdss-dsi-mdp-trigger = "none";
		qcom,mdss-dsi-bl-pmic-control-type = "bl_ctrl_wled";
		qcom,mdss-dsi-reset-sequence = <0x1 0x2 0x0 0x2 0x1 0x3>;
		qcom,mdss-dsi-panel-status-check-mode = "reg_read";
		qcom,mdss-dsi-panel-status-command = <0x6010001 0x500010a>;
		qcom,mdss-dsi-panel-status-command-state = "dsi_lp_mode";
		qcom,mdss-dsi-panel-status-read-length = <0x1>;
		qcom,mdss-dsi-panel-status-value = <0x1c>;
		qcom,mdss-pan-physical-width-dimension = <68>;
		qcom,mdss-pan-physical-height-dimension = <136>;
	};
};
