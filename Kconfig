## Kconfig
```kconfig
#
# For a description of the syntax of this configuration file,
# see Documentation/kbuild/kconfig-language.txt.
#
mainmenu "Linux/$ARCH $KERNELVERSION Kernel Configuration"

config SRCARCH
	string
	option env="SRCARCH"

config VENDOR_SMARTISAN
	bool "SMARTISAN support"
	help
	  This feature enables Smartisan specific hacks

config VENDOR_SMARTISAN_ODIN
	bool "SMARTISAN U2 Pro support"
	help
	  This feature enables Smartisan U2 Pro specific hacks

config VENDOR_SMARTISAN_OSCAR
	bool "SMARTISAN U3 support"
	help
	  This feature enables Smartisan U3 specific hacks

source "arch/$SRCARCH/Kconfig"
```

## drivers/fingerprint/Kconfig
```kconfig
menuconfig FINGERPRINT
	tristate "Fingerprint Config Choosen"
	default y
	help
	  Say Y to can config finperprint manufacturer

if FINGERPRINT

	source "drivers/fingerprint/goodix_odin/Kconfig"
	source "drivers/fingerprint/goodix_oscar/Kconfig"

endif
```

## drivers/fingerprint/goodix_oscar/Kconfig
```kconfig
config FINGERPRINT_GOODIX_GF3206
	tristate "Goodix fingerprint drvier support"
	depends on FINGERPRINT
	help
	  Say Y here to enable goodix fingerprint driver support!
```

## drivers/fingerprint/idex/Kconfig
```kconfig
config FINGERPRINT_IX_BTP
	tristate "IX fingerprint sensor support"
	depends on SPI_MASTER
```
